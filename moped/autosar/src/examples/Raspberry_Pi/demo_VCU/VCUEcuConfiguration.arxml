AUTOSAR XML (schema 4-1-1)
package /ARRoot
  ecuc value collection VCU: ecu-extract=demo_VCU_Extract_v4EcuExtract, ecuc-values=[Com, Os, Rte, EcuC, PduR, CanIf, Can, CanTp]
  module config Com: implementation-config-variant=VARIANT-POST-BUILD, module-description=Com
    ComConfig: ComConfigurationId=(unset)
      ComTimeBase: ComRxTimeBase=0.001, ComTxTimeBase=0.001
      pluginInstallationVCUComIPdu (ComIPdu):
        ComIPduDirection = RECEIVE
        ComIPduSignalProcessing = IMMEDIATE
        ComIPduTriggerTransmitCallout = NULL
        ComIPduType = 
        ComPduIdRef = plugInInstallationVCUPdu
        ComIPduSignalRef = pluginInstallationVCUsignal
        ComIPduGroupRef = RxIPduGroup
      pluginInstallationVCUsignal (ComSignal):
        ComBitPosition = 0
        ComHandleId = (unset)
        ComSignalEndianness = opaque
        ComSignalType = UINT8_N
        ComTransferProperty = PENDING
        ComSignalInitValue = 0x00
        ComSignalLength = 8
        ComFirstTimeout = 0
        ComTimeout = 0
        ComSystemTemplateSystemSignalRef = pluginInstallationVCUsignalargInt32Mapping
      TxIPduGroup (ComIPduGroup): ComIPduGroupHandleId=(unset)
      3 x ComSignal, all with ComBitPosition=0, ComHandleId=(unset), ComSignalEndianness=opaque, ComSignalType=UINT8_N, ComSignalInitValue=0, ComFirstTimeout=0, ComTimeout=0:
        pluginCommunicationVCUtoTCUsignal: ComSignalLength=8, ComTransferProperty=TRIGGERED, ComSystemTemplateSystemSignalRef=pluginCommunicationVCUtoTCUsignalacknowledgementVCUMapping
        pluginCommunicationTCUtoVCUsignal: ComSignalLength=8, ComTransferProperty=PENDING, ComSystemTemplateSystemSignalRef=pluginCommunicationTCUtoVCUsignalargInt32Mapping
        acknowledgementVCUsignal: ComTransferProperty=TRIGGERED, ComSignalLength=1, ComSystemTemplateSystemSignalRef=acknowledgementVCUsignalacknowledgementVCUMapping
      3 x ComIPdu, all with ComIPduSignalProcessing=IMMEDIATE, ComIPduTriggerTransmitCallout=NULL, ComIPduType=:
        alacknowledgementVCUComIPdu: ComIPduDirection=SEND, ComPduIdRef=acknowledgementVCUPdu, ComIPduGroupRef=TxIPduGroup, ComIPduSignalRef=acknowledgementVCUsignal
          ComTxIPdu: ComTxIPduUnusedAreasDefault=0
            ComTxModeTrue
              ComTxMode: ComTxModeMode=DIRECT, ComTxModeTimePeriod=0, ComTxModeTimeOffset=0
        pluginCommunicationTCUtoVCUComIPdu: ComIPduDirection=RECEIVE, ComPduIdRef=pluginCommunicationTCUtoVCUPdu, ComIPduGroupRef=RxIPduGroup, ComIPduSignalRef=pluginCommunicationTCUtoVCUsignal
        pluginCommunicationVCUtoTCUComIPdu: ComIPduDirection=SEND, ComPduIdRef=pluginCommunicationVCUtoTCUPdu, ComIPduGroupRef=TxIPduGroup, ComIPduSignalRef=pluginCommunicationVCUtoTCUsignal
          ComTxIPdu: ComTxIPduUnusedAreasDefault=0
            ComTxModeTrue
              ComTxMode: ComTxModeMode=DIRECT, ComTxModeTimePeriod=0, ComTxModeTimeOffset=0
      RxIPduGroup (ComIPduGroup): ComIPduGroupHandleId=(unset)
      driverSetSpeedSteeringSignal (ComSignal):
        ComBitPosition = 0
        ComHandleId = (unset)
        ComSignalEndianness = opaque
        ComSignalType = UINT8_N
        ComTransferProperty = PENDING
        ComSignalLength = 2
        ComSignalInitValue = 0
        ComFirstTimeout = 0
        ComTimeout = 0
        ComSystemTemplateSystemSignalRef = driverSetSpeedSteeringSignaldataInt32Mapping
      pluginCommunicationVCUtoSCUSignal (ComSignal):
        ComBitPosition = 0
        ComHandleId = (unset)
        ComSignalEndianness = opaque
        ComSignalType = UINT8_N
        ComTransferProperty = TRIGGERED
        ComSignalInitValue = 0
        ComSignalLength = 8
        ComFirstTimeout = 0
        ComTimeout = 0
        ComSystemTemplateSystemSignalRef = pluginCommunicationVCUtoSCUsignalargInt32Mapping
      driverSetSpeedSteeringComIPdu (ComIPdu):
        ComIPduDirection = RECEIVE
        ComIPduSignalProcessing = IMMEDIATE
        ComIPduTriggerTransmitCallout = NULL
        ComIPduType = 
        ComPduIdRef = driverSetSpeedSteeringPdu
        ComIPduGroupRef = RxIPduGroup
        ComIPduSignalRef = driverSetSpeedSteeringSignal
      pluginCommunicationSCUtoVCUSignal (ComSignal):
        ComBitPosition = 0
        ComHandleId = (unset)
        ComSignalEndianness = opaque
        ComSignalType = UINT8_N
        ComTransferProperty = PENDING
        ComSignalInitValue = 0
        ComSignalLength = 8
        ComFirstTimeout = 0
        ComTimeout = 0
        ComSystemTemplateSystemSignalRef = pluginCommunicationSCUtoVCUsignalargInt32Mapping
      pluginCommunicationSCUtoVCUComIPdu (ComIPdu):
        ComIPduDirection = RECEIVE
        ComIPduSignalProcessing = IMMEDIATE
        ComIPduTriggerTransmitCallout = NULL
        ComIPduType = 
        ComPduIdRef = pluginCommunicationSCUtoVCUPdu
        ComIPduGroupRef = RxIPduGroup
        ComIPduSignalRef = pluginCommunicationSCUtoVCUSignal
      pluginCommunicationVCUtoSCUComIPdu (ComIPdu):
        ComIPduDirection = SEND
        ComIPduSignalProcessing = IMMEDIATE
        ComIPduTriggerTransmitCallout = NULL
        ComIPduType = 
        ComPduIdRef = pluginCommunicationVCUtoSCUPdu
        ComIPduGroupRef = TxIPduGroup
        ComIPduSignalRef = pluginCommunicationVCUtoSCUSignal
        ComTxIPdu: ComTxIPduUnusedAreasDefault=0
          ComTxModeTrue
            ComTxMode: ComTxModeMode=DIRECT, ComTxModeTimeOffset=0, ComTxModeTimePeriod=0
      positionDataSignal (ComSignal):
        ComBitPosition = 0
        ComHandleId = (unset)
        ComSignalEndianness = opaque
        ComSignalType = UINT8_N
        ComTransferProperty = PENDING
        ComSignalLength = 8
        ComSignalInitValue = 0
        ComFirstTimeout = 0
        ComTimeout = 0
        ComSystemTemplateSystemSignalRef = positionSignalargInt32Mapping
      positionDataComIPdu (ComIPdu):
        ComIPduDirection = RECEIVE
        ComIPduSignalProcessing = IMMEDIATE
        ComIPduTriggerTransmitCallout = NULL
        ComIPduType = 
        ComPduIdRef = poistionDataPdu
        ComIPduGroupRef = RxIPduGroup
        ComIPduSignalRef = positionDataSignal
    ComGeneral:
      ComSupportedIPduGroups = 4
      ComVersionInfoApi = 0
      ComSupportedIPdus = 20
      ComSupportedSignals = 40
      ComSupportedGroupSignals = 40
      ComRamBufferSize = 150
      ComConfigurationUseDet = 1
  module config Os: implementation-config-variant=VARIANT-PRE-COMPILE, module-description=Os
    OsAppMode
    OsOS:
      OsScalabilityClass = SC1
      OsStackMonitoring = 1
      OsStatus = STANDARD
      OsUseGetServiceId = 1
      OsUseParameterAccess = 1
      OsUseResScheduler = 1
      ArcOsTickFrequency = 1000
      ArcOsInterruptStackSize = 2048
      ArcOsIdleStackSize = 512
      ArcOsMaxIsr = 10
      OsHooks: OsErrorHook=1, OsPostTaskHook=0, OsPreTaskHook=0, OsShutdownHook=1, OsStartupHook=1
      ArcOsDebug: OsTaskDebug=0, OsAlarmDebug=0, OsResourceDebug=0, OsScheduleTableDebug=0, OsEventDebug=0, OsDebugActivated=0
    CanFunctionAlarm (OsAlarm): OsAlarmCounterRef=OsCounter
      OsAlarmAction
        OsAlarmSetEvent: OsAlarmSetEventRef=CanFunctionEvent, OsAlarmSetEventTaskRef=CanFunctionTask
      OsAlarmAutostart: OsAlarmAlarmTime=5, OsAlarmAutostartType=ABSOLUTE, OsAlarmCycleTime=5, OsAlarmAppModeRef=(unset)
    OsApplication:
      OsTrusted = 0
      OsAppAlarmRef = CanFunctionAlarm
      OsAppAlarmRef = RteFunctionAlarm
      OsAppCounterRef = OsCounter
      OsAppTaskRef = CanFunctionTask
      OsAppTaskRef = RteTask
      OsAppTaskRef = StartupTask
      OsAppAlarmRef = SensorAlarm
      OsAppTaskRef = SensorTask
      OsAppTaskRef = ActuatorTask
      OsAppTaskRef = SquawkTask
      OsAppAlarmRef = SquawkAlarm
      OsApplicationHooks: OsAppErrorHook=0, OsAppShutdownHook=0, OsAppStartupHook=0
    CanFunctionEvent (OsEvent)
    OsCounter: OsCounterMaxAllowedValue=, OsCounterMinCycle=1, OsCounterTicksPerBase=(unset), OsCounterType=OS_TICK
    CanFunctionTask (OsTask): OsTaskActivation=1, OsTaskPriority=7, OsTaskSchedule=FULL, ArcOsTaskStackSize=2048, OsTaskEventRef=CanFunctionEvent
      OsTaskAutostart: OsTaskAppModeRef=(unset)
    RteFunctionAlarm (OsAlarm): OsAlarmCounterRef=OsCounter
      OsAlarmAction
        OsAlarmSetEvent: OsAlarmSetEventRef=RteFunctionEvent, OsAlarmSetEventTaskRef=RteTask
      OsAlarmAutostart: OsAlarmAlarmTime=20, OsAlarmAutostartType=ABSOLUTE, OsAlarmCycleTime=20, OsAlarmAppModeRef=(unset)
    RteFunctionEvent (OsEvent)
    OsSpinlock: OsSpinlockAccessingApplication=(unset)
    4 x OsTask, all with OsTaskActivation=1, OsTaskSchedule=FULL, ArcOsTaskStackSize=2048:
      RteTask: OsTaskPriority=4, OsTaskEventRef=RteFunctionEvent, OsTaskEventRef=AdcEvent, OsTaskEventRef=FrontWheelEvent, OsTaskEventRef=RearWheelEvent, OsTaskEventRef=pluginInstallationEvent, OsTaskEventRef=pluginCommunicationSCUEvent, OsTaskEventRef=pluginCommunicationTCUEvent, OsTaskEventRef=positionDataEvent, OsTaskEventRef=SpeedSteerEvent
        OsTaskAutostart: OsTaskAppModeRef=(unset)
      StartupTask: OsTaskPriority=8
        OsTaskAutostart: OsTaskAppModeRef=(unset)
      ActuatorTask: OsTaskPriority=6, OsTaskEventRef=SpeedEvent, OsTaskEventRef=ServoEvent, OsTaskEventRef=LedEvent, OsTaskEventRef=SpeedSelectEvent, OsTaskEventRef=SteerSelectEvent
        OsTaskAutostart: OsTaskAppModeRef=(unset)
      SensorTask: OsTaskPriority=3, OsTaskEventRef=SensorEvent
        OsTaskAutostart: OsTaskAppModeRef=(unset)
    SpeedEvent (OsEvent)
    SensorEvent (OsEvent)
    SensorAlarm (OsAlarm): OsAlarmCounterRef=OsCounter
      OsAlarmAction
        OsAlarmSetEvent: OsAlarmSetEventRef=SensorEvent, OsAlarmSetEventTaskRef=SensorTask
      OsAlarmAutostart: OsAlarmAlarmTime=1000, OsAlarmAutostartType=ABSOLUTE, OsAlarmCycleTime=1000, OsAlarmAppModeRef=(unset)
    5 x OsEvent:
      ServoEvent
      AdcEvent
      FrontWheelEvent
      RearWheelEvent
      pluginInstallationEvent
    SquawkTask (OsTask): OsTaskActivation=1, OsTaskPriority=2, OsTaskSchedule=FULL, ArcOsTaskStackSize=10485760, OsTaskEventRef=SquawkEvent
      OsTaskAutostart: OsTaskAppModeRef=(unset)
    pluginacknowledgeVCUEvent (OsEvent)
    SquawkAlarm (OsAlarm): OsAlarmCounterRef=OsCounter
      OsAlarmAction
        OsAlarmSetEvent: OsAlarmSetEventRef=SquawkEvent, OsAlarmSetEventTaskRef=SquawkTask
      OsAlarmAutostart: OsAlarmAlarmTime=20, OsAlarmAutostartType=ABSOLUTE, OsAlarmCycleTime=20, OsAlarmAppModeRef=(unset)
    8 x OsEvent:
      SquawkEvent
      pluginCommunicationSCUEvent
      pluginCommunicationTCUEvent
      positionDataEvent
      LedEvent
      SpeedSelectEvent
      SteerSelectEvent
      SpeedSteerEvent
  module config Rte: implementation-config-variant=VARIANT-PRE-COMPILE, module-description=Rte
    RteBswGeneral: RteSchMVersionInfoApi=(unset), RteUseComShadowSignalApi=0
    RteGeneration:
      RteCalibrationSupport = NONE
      RteCodeVendorId = (unset)
      RteDevErrorDetect = 0
      RteDevErrorDetectUninit = 0
      RteGenerationMode = COMPATIBILITY_MODE
      RteIocInteractionReturnValue = RTE_IOC
      RteMeasurementSupport = 0
      RteOptimizationMode = RUNTIME
      RteValueRangeCheckEnabled = 0
      RteVfbTraceEnabled = 0
    RteInitializationBehavior: RteInitializationStrategy=, RteSectionInitializationPolicy=
    RteOsInteraction
    RtePostBuildVariantConfiguration: RtePostBuildUsedPredefinedVariant=(unset)
    8 x RteSwComponentInstance:
      PirteSWCProto: RteSoftwareComponentInstanceRef=PirteSWCProto
        7 x RteEventToTaskMapping, all with RteImmediateRestart=0, RteMappedToTaskRef=RteTask:
          AdcEvent_RteTask: RtePositionInTask=1, RteEventRef=AdcEvent, RteUsedOsEventRef=AdcEvent
          FrontWheelEvent_RteTask: RtePositionInTask=2, RteEventRef=FrontWheelEvent, RteUsedOsEventRef=FrontWheelEvent
          PirteReadDataFromSCUEvent_RteTask: RtePositionInTask=3, RteEventRef=PirteReadDataFromSCUEvent, RteUsedOsEventRef=pluginCommunicationSCUEvent
          PirteReadDataFromTCUEvent_RteTask: RtePositionInTask=4, RteEventRef=PirteReadDataFromTCUEvent, RteUsedOsEventRef=pluginCommunicationTCUEvent
          PirteReadPositionDataEvent_RteTask: RtePositionInTask=5, RteEventRef=PirteReadPositionDataEvent, RteUsedOsEventRef=positionDataEvent
          PirteReadSpeedSteerEvent_RteTask: RtePositionInTask=6, RteEventRef=PirteReadSpeedSteerEvent, RteUsedOsEventRef=SpeedSteerEvent
          RearWheelEvent_RteTask: RtePositionInTask=3, RteEventRef=RearWheelEvent, RteUsedOsEventRef=RearWheelEvent
      AdcSWCProto: RteSoftwareComponentInstanceRef=AdcSWCProto
      FrontWheelSWCProto: RteSoftwareComponentInstanceRef=FrontWheelSWCProto
      IoHwAbProto: RteSoftwareComponentInstanceRef=IoHwAbProto
      LedSWCProto: RteSoftwareComponentInstanceRef=LedSWCProto
        LedReadDataFromPirteEvent_RteTask (RteEventToTaskMapping): RteImmediateRestart=0, RtePositionInTask=7, RteEventRef=LedReadDataFromPirteEvent, RteMappedToTaskRef=ActuatorTask, RteUsedOsEventRef=LedEvent
      MotorSWCProto: RteSoftwareComponentInstanceRef=MotorSWCProto
        3 x RteEventToTaskMapping, all with RteImmediateRestart=0, RteMappedToTaskRef=ActuatorTask:
          MotorReadDataFromPirteEvent_ActuatorTask: RtePositionInTask=1, RteEventRef=MotorReadDataFromPirteEvent, RteUsedOsEventRef=SpeedEvent
          MotorReadDataFromTCUEvent_ActuatorTask: RtePositionInTask=2, RteEventRef=MotorReadDataFromTCUEvent, RteUsedOsEventRef=SpeedEvent
          SpeedSelectEvent_ActuatorTask: RtePositionInTask=5, RteEventRef=SpeedSelectEvent, RteUsedOsEventRef=SpeedSelectEvent
      RearWheelSWCProto: RteSoftwareComponentInstanceRef=RearWheelSWCProto
      ServoSWCProto: RteSoftwareComponentInstanceRef=ServoSWCProto
        3 x RteEventToTaskMapping, all with RteImmediateRestart=0, RteMappedToTaskRef=ActuatorTask:
          ServoReadDataFromTCUEvent_ActuatorTask: RtePositionInTask=3, RteEventRef=ServoReadDataFromTCUEvent, RteUsedOsEventRef=ServoEvent
          SteerReadDataFromPirteEvent_ActuatorTask: RtePositionInTask=4, RteEventRef=SteerReadDataFromPirteEvent, RteUsedOsEventRef=ServoEvent
          SteerSelectEvent_ActuatorTask: RtePositionInTask=6, RteEventRef=SteerSelectEvent, RteUsedOsEventRef=SteerSelectEvent
  module config EcuC: implementation-config-variant=VARIANT-PRE-COMPILE, module-description=EcuC
    EcucPduCollection: PduIdTypeEnum=UINT16, PduLengthTypeEnum=UINT16
      8 x Pdu:
        plugInInstallationVCUPdu: PduLength=8
        acknowledgementVCUPdu: PduLength=1
        pluginCommunicationVCUtoTCUPdu: PduLength=8
        pluginCommunicationTCUtoVCUPdu: PduLength=8
        driverSetSpeedSteeringPdu: PduLength=2
        pluginCommunicationVCUtoSCUPdu: PduLength=8
        pluginCommunicationSCUtoVCUPdu: PduLength=8
        poistionDataPdu: PduLength=8
  module config PduR: implementation-config-variant=VARIANT-POST-BUILD, module-description=PduR
    PduRGeneral: PduRDevErrorDetect=0, PduRVersionInfoApi=0, PduRZeroCostOperation=1
    PduRRoutingTables: PduRConfigurationId=0, ArcPduRMaxRouteCount=50
      PduRRoutingTable: PduRIsMinimumRouting=0
        8 x PduRRoutingPath:
          acknowledgementVCUtx
            PduRDestPdu: ArcOverridenDestModule=CanIf, PduRDestPduRef=acknowledgementVCUPdu
            PduRSrcPdu: PduRSourcePduHandleId=(unset), ArcOverridenSrcModule=Com, PduRSrcPduRef=acknowledgementVCUPdu
          pluginCommunicationTCUtoVCUrx
            PduRDestPdu: ArcOverridenDestModule=Com, PduRDestPduRef=pluginCommunicationTCUtoVCUPdu
            PduRSrcPdu: PduRSourcePduHandleId=(unset), ArcOverridenSrcModule=CanIf, PduRSrcPduRef=pluginCommunicationTCUtoVCUPdu
          pluginCommunicationVCUtoTCUtx
            PduRDestPdu: ArcOverridenDestModule=CanIf, PduRDestPduRef=pluginCommunicationVCUtoTCUPdu
            PduRSrcPdu: PduRSourcePduHandleId=(unset), ArcOverridenSrcModule=Com, PduRSrcPduRef=pluginCommunicationVCUtoTCUPdu
          pluginInstallationVCUsignalrx
            PduRDestPdu: ArcOverridenDestModule=Com, PduRDestPduRef=plugInInstallationVCUPdu
            PduRSrcPdu: PduRSourcePduHandleId=(unset), ArcOverridenSrcModule=CanIf, PduRSrcPduRef=plugInInstallationVCUPdu
          driverSetSpeedSteeringrx
            PduRDestPdu: ArcOverridenDestModule=Com, PduRDestPduRef=driverSetSpeedSteeringPdu
            PduRSrcPdu: PduRSourcePduHandleId=(unset), ArcOverridenSrcModule=CanIf, PduRSrcPduRef=driverSetSpeedSteeringPdu
          pluginCommunicationVCUtoSCUtx
            PduRDestPdu: ArcOverridenDestModule=CanIf, PduRDestPduRef=pluginCommunicationVCUtoSCUPdu
            PduRSrcPdu: PduRSourcePduHandleId=(unset), ArcOverridenSrcModule=Com, PduRSrcPduRef=pluginCommunicationVCUtoSCUPdu
          pluginCommunicationSCUtoVCUrx
            PduRDestPdu: ArcOverridenDestModule=Com, PduRDestPduRef=pluginCommunicationSCUtoVCUPdu
            PduRSrcPdu: PduRSourcePduHandleId=(unset), ArcOverridenSrcModule=CanIf, PduRSrcPduRef=pluginCommunicationSCUtoVCUPdu
          positionDatarx
            PduRDestPdu: ArcOverridenDestModule=Com, PduRDestPduRef=poistionDataPdu
            PduRSrcPdu: PduRSourcePduHandleId=(unset), ArcOverridenSrcModule=CanIf, PduRSrcPduRef=poistionDataPdu
    CanIf (PduRBswModules):
      PduRCancelReceive = 0
      PduRCancelTransmit = (unset)
      PduRChangeParameterRequestApi = (unset)
      PduRCommunicationInterface = (unset)
      PduRLowerModule = 1
      PduRRetransmission = (unset)
      PduRTransportProtocol = (unset)
      PduRTriggertransmit = (unset)
      PduRTxConfirmation = (unset)
      PduRUpperModule = 0
      PduRUseTag = (unset)
      PduRBswModuleRef = (unset)
    Com (PduRBswModules):
      PduRCancelReceive = 0
      PduRCancelTransmit = (unset)
      PduRChangeParameterRequestApi = (unset)
      PduRCommunicationInterface = (unset)
      PduRLowerModule = 0
      PduRRetransmission = (unset)
      PduRTransportProtocol = (unset)
      PduRTriggertransmit = (unset)
      PduRTxConfirmation = (unset)
      PduRUpperModule = 1
      PduRUseTag = (unset)
      PduRBswModuleRef = (unset)
  module config CanIf: implementation-config-variant=VARIANT-PRE-COMPILE, module-description=CanIf
    CanIfCtrlDrvCfg: CanIfCtrlDrvTxCancellation=0, CanIfCtrlDrvInitHohConfigRef=CanIfInitHohCfg, CanIfCtrlDrvNameRef=(unset)
      CanIfCtrlCfg: CanIfCtrlId=(unset), CanIfCtrlWakeupSupport=0, CanIfCtrlCanCtrlRef=CanController
    CanIfDispatchCfg:
      CanIfDispatchUserConfirmPnAvailabilityName = 
      CanIfDispatchUserConfirmPnAvailabilityUL = 
      CanIfDispatchUserCtrlBusOffUL = 
      CanIfDispatchUserCtrlModeIndicationUL = 
    CanIfInitCfg: CanIfInitCfgSet=
      CanIfBufferCfg: CanIfBufferSize=0, CanIfBufferHthRef=CanIfHthCfg
      CanIfInitHohCfg: CanIfInitRefCfgSet=(unset)
        CanIfHrhCfg: CanIfHrhSoftwareFilter=1, CanIfHrhCanCtrlIdRef=CanIfCtrlCfg, CanIfHrhIdSymRef=CAN_RX
        CanIfHthCfg: CanIfHthCanCtrlIdRef=CanIfCtrlCfg, CanIfHthIdSymRef=CAN_TX
      pluginInstallationVCUCanIfRx (CanIfRxPduCfg):
        CanIfRxPduCanIdType = STANDARD_CAN
        CanIfRxPduDlc = 8
        CanIfRxPduId = (unset)
        CanIfRxPduReadData = 0
        CanIfRxPduReadNotifyStatus = 0
        CanIfRxPduCanId = 1601
        CanIfRxPduUserRxIndicationUL = PDUR
        CanIfRxPduBswSchExclAreaIdRef = (unset)
        CanIfRxPduHrhIdRef = CanIfHrhCfg
        CanIfRxPduRef = plugInInstallationVCUPdu
      pluginCommunicationTCUtoVCUCanIfRx (CanIfRxPduCfg):
        CanIfRxPduCanIdType = STANDARD_CAN
        CanIfRxPduDlc = 8
        CanIfRxPduId = (unset)
        CanIfRxPduReadData = 0
        CanIfRxPduReadNotifyStatus = 0
        CanIfRxPduCanId = 1129
        CanIfRxPduUserRxIndicationUL = PDUR
        CanIfRxPduBswSchExclAreaIdRef = (unset)
        CanIfRxPduHrhIdRef = CanIfHrhCfg
        CanIfRxPduRef = pluginCommunicationTCUtoVCUPdu
      acknowledgementVCUCanIfTx (CanIfTxPduCfg):
        CanIfTxPduCanId = 1284
        CanIfTxPduCanIdType = STANDARD_CAN
        CanIfTxPduDlc = 1
        CanIfTxPduId = (unset)
        CanIfTxPduReadNotifyStatus = 0
        CanIfTxPduType = STATIC
        CanIfTxPduUserTxConfirmationUL = PDUR
        CanIfTxPduBswSchExclAreaIdRef = (unset)
        CanIfTxPduBufferRef = CanIfBufferCfg
        CanIfTxPduRef = acknowledgementVCUPdu
      pluginCommunicationVCUtoTCUCanIfTx (CanIfTxPduCfg):
        CanIfTxPduCanId = 1124
        CanIfTxPduCanIdType = STANDARD_CAN
        CanIfTxPduDlc = 8
        CanIfTxPduId = (unset)
        CanIfTxPduReadNotifyStatus = 0
        CanIfTxPduType = STATIC
        CanIfTxPduUserTxConfirmationUL = PDUR
        CanIfTxPduBswSchExclAreaIdRef = (unset)
        CanIfTxPduBufferRef = CanIfBufferCfg
        CanIfTxPduRef = pluginCommunicationVCUtoTCUPdu
      driverSetSpeedSteeringCanIfRx (CanIfRxPduCfg):
        CanIfRxPduCanIdType = STANDARD_CAN
        CanIfRxPduDlc = 2
        CanIfRxPduId = (unset)
        CanIfRxPduReadData = 0
        CanIfRxPduReadNotifyStatus = 0
        CanIfRxPduCanId = 257
        CanIfRxPduUserRxIndicationUL = PDUR
        CanIfRxPduBswSchExclAreaIdRef = (unset)
        CanIfRxPduHrhIdRef = CanIfHrhCfg
        CanIfRxPduRef = driverSetSpeedSteeringPdu
      pluginCommunicationSCUtoVCUCanIfRx (CanIfRxPduCfg):
        CanIfRxPduCanIdType = STANDARD_CAN
        CanIfRxPduDlc = 8
        CanIfRxPduId = (unset)
        CanIfRxPduReadData = 0
        CanIfRxPduReadNotifyStatus = 0
        CanIfRxPduCanId = 1121
        CanIfRxPduUserRxIndicationUL = PDUR
        CanIfRxPduBswSchExclAreaIdRef = (unset)
        CanIfRxPduHrhIdRef = CanIfHrhCfg
        CanIfRxPduRef = pluginCommunicationSCUtoVCUPdu
      pluginCommunicationVCUtoSCUCanIfTx (CanIfTxPduCfg):
        CanIfTxPduCanId = 1122
        CanIfTxPduCanIdType = STANDARD_CAN
        CanIfTxPduDlc = 8
        CanIfTxPduId = (unset)
        CanIfTxPduReadNotifyStatus = 0
        CanIfTxPduType = STATIC
        CanIfTxPduUserTxConfirmationUL = PDUR
        CanIfTxPduBswSchExclAreaIdRef = (unset)
        CanIfTxPduBufferRef = CanIfBufferCfg
        CanIfTxPduRef = pluginCommunicationVCUtoSCUPdu
      posititonDataCanIfRx (CanIfRxPduCfg):
        CanIfRxPduCanIdType = STANDARD_CAN
        CanIfRxPduDlc = 8
        CanIfRxPduId = (unset)
        CanIfRxPduReadData = 0
        CanIfRxPduReadNotifyStatus = 0
        CanIfRxPduCanId = 1025
        CanIfRxPduUserRxIndicationUL = PDUR
        CanIfRxPduBswSchExclAreaIdRef = (unset)
        CanIfRxPduHrhIdRef = CanIfHrhCfg
        CanIfRxPduRef = poistionDataPdu
    CanIfPrivateCfg: CanIfPrivateDlcCheck=1, CanIfPrivateSoftwareFilterType=, CanIfSupportTTCAN=0
    CanIfPublicCfg:
      CanIfPublicCancelTransmitSupport = 0
      CanIfPublicChangeBaudrateSupport = 0
      CanIfPublicDevErrorDetect = 1
      CanIfPublicHandleTypeEnum = 
      CanIfPublicMultipleDrvSupport = 1
      CanIfPublicNumberOfCanHwUnits = 1
      CanIfPublicPnSupport = 0
      CanIfPublicReadRxPduDataApi = 0
      CanIfPublicReadRxPduNotifyStatusApi = 0
      CanIfPublicReadTxPduNotifyStatusApi = 0
      CanIfPublicSetDynamicTxIdApi = 0
      CanIfPublicTxBuffering = 0
      CanIfPublicTxConfirmPollingSupport = 0
      CanIfPublicVersionInfoApi = 0
      CanIfPublicWakeupCheckValidSupport = 0
      ArcCanIfPublicTxBufferSize = 0
      ArcCanIfPublicMaxNumberOfTxBuffers = 0
  module config Can: implementation-config-variant=VARIANT-PRE-COMPILE, module-description=Can
    CanConfigSet
      CanController:
        CanBusoffProcessing = POLLING
        CanControllerActivation = 1
        CanControllerBaseAddress = (unset)
        CanControllerId = 0
        CanRxProcessing = POLLING
        CanTxProcessing = POLLING
        CanWakeupProcessing = POLLING
        CanWakeupSupport = 0
        ArcCanControllerLoopback = 0
        CanControllerDefaultBaudrate = CanControllerBaudrateConfig
        CanCpuClockRef = (unset)
        CanControllerBaudrateConfig: CanControllerBaudRate=500, CanControllerPropSeg=6, CanControllerSeg1=6, CanControllerSeg2=3, CanControllerSyncJumpWidth=2
        CanFilterMask: CanFilterMaskValue=0
      CAN_RX (CanHardwareObject):
        CanHandleType = BASIC
        CanIdType = STANDARD
        CanIdValue = 2
        CanObjectId = (unset)
        CanObjectType = RECEIVE
        CanControllerRef = CanController
        CanFilterMaskRef = CanFilterMask
      CAN_TX (CanHardwareObject): CanHandleType=BASIC, CanIdType=STANDARD, CanIdValue=1, CanObjectId=(unset), CanObjectType=TRANSMIT, CanControllerRef=CanController
    CanGeneral:
      CanChangeBaudrateApi = 0
      CanDevErrorDetection = 1
      CanHardwareCancellation = 0
      CanIdenticalIdCancellation = 0
      CanIndex = (unset)
      CanMainFunctionModePeriod = (unset)
      CanMultiplexedTransmission = 0
      CanTimeoutDuration = (unset)
      CanVersionInfoApi = 0
      CanCounterRef = (unset)
      CanSupportTTCANRef = (unset)
      CanMainFunctionRWPeriods
  module config CanTp: implementation-config-variant=VARIANT-POST-BUILD, module-description=CanTp
    CanTpConfig: CanTpMainFunctionPeriod=0.005
      CanTpChannel: CanTpChannelMode=
        pluginInstallationVCUCanTpRxNSdu (CanTpRxNSdu):
          CanTpNbr = 0.02
          CanTpRxAddressingFormat = CANTP_STANDARD
          CanTpRxDl = 8
          CanTpRxNSduId = (unset)
          CanTpRxPaddingActivation = CANTP_ON
          CanTpRxTaType = CANTP_PHYSICAL
          CanTpBs = 0
          CanTpRxWftMax = 255
          CanTpNar = 1.0
          CanTpNcr = 1
          CanTpSTmin = 0.005
          CanTpRxNSduRef = plugInInstallationVCUPdu
          CanTpRxNPdu: CanTpRxNPduId=(unset), CanTpRxNPduRef=plugInInstallationVCUPdu
          CanTpTxFcNPdu: CanTpTxFcNPduConfirmationPduId=(unset), CanTpTxFcNPduRef=pluginCommunicationVCUtoTCUPdu
    CanTpGeneral: CanTpChangeParameterApi=0, CanTpDevErrorDetect=1, CanTpPaddingByte=0, CanTpReadParameterApi=0, CanTpVersionInfoApi=0, CanTpMaxSDUs=3
