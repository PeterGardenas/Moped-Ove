AUTOSAR XML (schema 4-1-1)
package /ARRoot
  ecuc value collection SCU: ecu-extract=demo_SCUEcuExtract, ecuc-values=[Os, Rte, EcuC, CanIf, Com, PduR, Can]
  module config Os: implementation-config-variant=VARIANT-PRE-COMPILE, module-description=Os
    OsAppMode
    OsOS:
      OsScalabilityClass = SC1
      OsStackMonitoring = 1
      OsStatus = STANDARD
      OsUseGetServiceId = 1
      OsUseParameterAccess = 1
      OsUseResScheduler = 1
      ArcOsTickFrequency = 100
      ArcOsInterruptStackSize = 2048
      ArcOsIdleStackSize = 512
      ArcOsMaxIsr = 10
      OsHooks: OsErrorHook=1, OsPostTaskHook=0, OsPreTaskHook=0, OsShutdownHook=1, OsStartupHook=1
      ArcOsDebug: OsTaskDebug=0, OsAlarmDebug=0, OsResourceDebug=0, OsScheduleTableDebug=0, OsEventDebug=0, OsDebugActivated=0
    4 x OsTask, all with OsTaskActivation=1, OsTaskSchedule=FULL, ArcOsTaskStackSize=2048:
      CanFunctionTask: OsTaskPriority=7, OsTaskEventRef=CanFunctionEvent
        OsTaskAutostart: OsTaskAppModeRef=(unset)
      RteTask: OsTaskPriority=5, OsTaskEventRef=IMUEvent, OsTaskEventRef=RteEvent, OsTaskEventRef=UltraEvent, OsTaskEventRef=SCUInstallationEvent, OsTaskEventRef=TCUCommunicationEvent, OsTaskEventRef=VCUCommunicationEvent
        OsTaskAutostart: OsTaskAppModeRef=(unset)
      StartupTask: OsTaskPriority=8
        OsTaskAutostart: OsTaskAppModeRef=(unset)
      SensorTask: OsTaskPriority=4, OsTaskEventRef=SensorEvent
        OsTaskAutostart: OsTaskAppModeRef=(unset)
    CanFuntionAlarm (OsAlarm): OsAlarmCounterRef=OsCounter
      OsAlarmAction
        OsAlarmSetEvent: OsAlarmSetEventRef=CanFunctionEvent, OsAlarmSetEventTaskRef=CanFunctionTask
      OsAlarmAutostart: OsAlarmAlarmTime=5, OsAlarmAutostartType=ABSOLUTE, OsAlarmCycleTime=5, OsAlarmAppModeRef=(unset)
    OsApplication:
      OsTrusted = 0
      OsAppAlarmRef = CanFuntionAlarm
      OsAppAlarmRef = RteAlarm
      OsAppAlarmRef = SensorAlarm
      OsAppCounterRef = OsCounter
      OsAppTaskRef = CanFunctionTask
      OsAppTaskRef = RteTask
      OsAppTaskRef = SensorTask
      OsAppTaskRef = SquawkTask
      OsAppTaskRef = StartupTask
      OsApplicationHooks: OsAppErrorHook=0, OsAppShutdownHook=0, OsAppStartupHook=0
    CanFunctionEvent (OsEvent)
    OsCounter: OsCounterMaxAllowedValue=, OsCounterMinCycle=1, OsCounterTicksPerBase=(unset), OsCounterType=OS_TICK
    SensorAlarm (OsAlarm): OsAlarmCounterRef=OsCounter
      OsAlarmAction
        OsAlarmSetEvent: OsAlarmSetEventRef=SensorEvent, OsAlarmSetEventTaskRef=SensorTask
      OsAlarmAutostart: OsAlarmAlarmTime=100, OsAlarmAutostartType=RELATIVE, OsAlarmCycleTime=100, OsAlarmAppModeRef=(unset)
    SensorEvent (OsEvent)
    RteEvent (OsEvent)
    RteAlarm (OsAlarm): OsAlarmCounterRef=OsCounter
      OsAlarmAction
        OsAlarmSetEvent: OsAlarmSetEventRef=RteEvent, OsAlarmSetEventTaskRef=RteTask
      OsAlarmAutostart: OsAlarmAlarmTime=20, OsAlarmAutostartType=ABSOLUTE, OsAlarmCycleTime=20, OsAlarmAppModeRef=(unset)
    SquawkTask (OsTask): OsTaskActivation=1, OsTaskPriority=2, OsTaskSchedule=FULL, ArcOsTaskStackSize=2048
      OsTaskAutostart: OsTaskAppModeRef=(unset)
    5 x OsEvent:
      IMUEvent
      UltraEvent
      SCUInstallationEvent
      VCUCommunicationEvent
      TCUCommunicationEvent
  module config Rte: implementation-config-variant=VARIANT-PRE-COMPILE, module-description=Rte
    RteBswGeneral: RteSchMVersionInfoApi=(unset), RteUseComShadowSignalApi=0
    RteGeneration:
      RteCalibrationSupport = NONE
      RteCodeVendorId = (unset)
      RteDevErrorDetect = 0
      RteDevErrorDetectUninit = 0
      RteGenerationMode = COMPATIBILITY_MODE
      RteIocInteractionReturnValue = RTE_IOC
      RteMeasurementSupport = 0
      RteOptimizationMode = RUNTIME
      RteValueRangeCheckEnabled = 0
      RteVfbTraceEnabled = 0
    RteInitializationBehavior: RteInitializationStrategy=, RteSectionInitializationPolicy=
    RteOsInteraction
    RtePostBuildVariantConfiguration: RtePostBuildUsedPredefinedVariant=(unset)
    4 x RteSwComponentInstance:
      PirteSWCProto: RteSoftwareComponentInstanceRef=PirteSWCProto
        5 x RteEventToTaskMapping, all with RteImmediateRestart=0, RteMappedToTaskRef=RteTask:
          IMUDataInEvent_RteTask: RtePositionInTask=1, RteEventRef=IMUDataInEvent, RteUsedOsEventRef=IMUEvent
          SCUInstallEvent_RteTask: RtePositionInTask=3, RteEventRef=SCUInstallEvent, RteUsedOsEventRef=SCUInstallationEvent
          TCUdataInEvent_RteTask: RtePositionInTask=4, RteEventRef=TCUdataInEvent, RteUsedOsEventRef=TCUCommunicationEvent
          UltraDataInEvent_RteTask: RtePositionInTask=2, RteEventRef=UltraDataInEvent, RteUsedOsEventRef=UltraEvent
          VCUdataInEvent_RteTask: RtePositionInTask=5, RteEventRef=VCUdataInEvent, RteUsedOsEventRef=VCUCommunicationEvent
      IoHwAbService: RteSoftwareComponentInstanceRef=IoHwAbService
      ImuSWCProto: RteSoftwareComponentInstanceRef=ImuSWCProto
      UltraSWCProto: RteSoftwareComponentInstanceRef=UltraSWCProto
  module config EcuC: implementation-config-variant=VARIANT-PRE-COMPILE, module-description=EcuC
    EcucPduCollection: PduIdTypeEnum=UINT16, PduLengthTypeEnum=UINT16
      6 x Pdu:
        pluginInstallationSCUPdu: PduLength=8
        pluginCommunicationSCUtoVCUPdu: PduLength=8
        pluginCommunicationSCUtoTCUPdu: PduLength=8
        pluginCommunicationVCUtoSCUPdu: PduLength=8
        pluginCommunicationTCUtoSCUPdu: PduLength=8
        acknowledegmentSCUPdu: PduLength=1
  module config CanIf: implementation-config-variant=VARIANT-PRE-COMPILE, module-description=CanIf
    CanIfCtrlDrvCfg: CanIfCtrlDrvTxCancellation=0, CanIfCtrlDrvInitHohConfigRef=CanIfInitHohCfg, CanIfCtrlDrvNameRef=(unset)
      CanIfCtrlCfg: CanIfCtrlId=(unset), CanIfCtrlWakeupSupport=0, CanIfCtrlCanCtrlRef=CanController
    CanIfDispatchCfg:
      CanIfDispatchUserConfirmPnAvailabilityName = 
      CanIfDispatchUserConfirmPnAvailabilityUL = 
      CanIfDispatchUserCtrlBusOffUL = 
      CanIfDispatchUserCtrlModeIndicationUL = 
    CanIfInitCfg: CanIfInitCfgSet=
      CanIfBufferCfg: CanIfBufferSize=0, CanIfBufferHthRef=CanIfHthCfg
      CanIfInitHohCfg: CanIfInitRefCfgSet=(unset)
        CanIfHrhCfg: CanIfHrhSoftwareFilter=1, CanIfHrhCanCtrlIdRef=CanIfCtrlCfg, CanIfHrhIdSymRef=CAN_RX
        CanIfHthCfg: CanIfHthCanCtrlIdRef=CanIfCtrlCfg, CanIfHthIdSymRef=CAN_TX
      pluginCommunicationVCUtoSCUCanIfRx (CanIfRxPduCfg):
        CanIfRxPduCanIdType = STANDARD_CAN
        CanIfRxPduDlc = 8
        CanIfRxPduId = (unset)
        CanIfRxPduReadData = 0
        CanIfRxPduReadNotifyStatus = 0
        CanIfRxPduCanId = 1122
        CanIfRxPduUserRxIndicationUL = PDUR
        CanIfRxPduBswSchExclAreaIdRef = (unset)
        CanIfRxPduHrhIdRef = CanIfHrhCfg
        CanIfRxPduRef = pluginCommunicationVCUtoSCUPdu
      acknowledgementSCUCanIfTx (CanIfTxPduCfg):
        CanIfTxPduCanId = 1292
        CanIfTxPduCanIdType = STANDARD_CAN
        CanIfTxPduDlc = 1
        CanIfTxPduId = (unset)
        CanIfTxPduReadNotifyStatus = 0
        CanIfTxPduType = STATIC
        CanIfTxPduUserTxConfirmationUL = PDUR
        CanIfTxPduBswSchExclAreaIdRef = (unset)
        CanIfTxPduBufferRef = CanIfBufferCfg
        CanIfTxPduRef = acknowledegmentSCUPdu
      pluginInstallationSCUCanIfRx (CanIfRxPduCfg):
        CanIfRxPduCanIdType = STANDARD_CAN
        CanIfRxPduDlc = 8
        CanIfRxPduId = (unset)
        CanIfRxPduReadData = 0
        CanIfRxPduReadNotifyStatus = 0
        CanIfRxPduCanId = 1602
        CanIfRxPduUserRxIndicationUL = PDUR
        CanIfRxPduBswSchExclAreaIdRef = (unset)
        CanIfRxPduHrhIdRef = CanIfHrhCfg
        CanIfRxPduRef = pluginInstallationSCUPdu
      pluginCommunicationTCUtoSCUCanIfRx (CanIfRxPduCfg):
        CanIfRxPduCanIdType = STANDARD_CAN
        CanIfRxPduDlc = 8
        CanIfRxPduId = (unset)
        CanIfRxPduReadData = 0
        CanIfRxPduReadNotifyStatus = 0
        CanIfRxPduCanId = 1130
        CanIfRxPduUserRxIndicationUL = PDUR
        CanIfRxPduBswSchExclAreaIdRef = (unset)
        CanIfRxPduHrhIdRef = CanIfHrhCfg
        CanIfRxPduRef = pluginCommunicationTCUtoSCUPdu
      pluginCommunicationSCUtoTCUCanIfTx (CanIfTxPduCfg):
        CanIfTxPduCanId = 1132
        CanIfTxPduCanIdType = STANDARD_CAN
        CanIfTxPduDlc = 8
        CanIfTxPduId = (unset)
        CanIfTxPduReadNotifyStatus = 0
        CanIfTxPduType = STATIC
        CanIfTxPduUserTxConfirmationUL = PDUR
        CanIfTxPduBswSchExclAreaIdRef = (unset)
        CanIfTxPduBufferRef = CanIfBufferCfg
        CanIfTxPduRef = pluginCommunicationSCUtoTCUPdu
      pluginCommunicationSCUtoVCUCanIfTx (CanIfTxPduCfg):
        CanIfTxPduCanId = 1121
        CanIfTxPduCanIdType = STANDARD_CAN
        CanIfTxPduDlc = 8
        CanIfTxPduId = (unset)
        CanIfTxPduReadNotifyStatus = 0
        CanIfTxPduType = STATIC
        CanIfTxPduUserTxConfirmationUL = PDUR
        CanIfTxPduBswSchExclAreaIdRef = (unset)
        CanIfTxPduBufferRef = CanIfBufferCfg
        CanIfTxPduRef = pluginCommunicationSCUtoVCUPdu
    CanIfPrivateCfg: CanIfPrivateDlcCheck=1, CanIfPrivateSoftwareFilterType=, CanIfSupportTTCAN=0
    CanIfPublicCfg:
      CanIfPublicCancelTransmitSupport = 0
      CanIfPublicChangeBaudrateSupport = 0
      CanIfPublicDevErrorDetect = 1
      CanIfPublicHandleTypeEnum = 
      CanIfPublicMultipleDrvSupport = 1
      CanIfPublicNumberOfCanHwUnits = 1
      CanIfPublicPnSupport = 0
      CanIfPublicReadRxPduDataApi = 0
      CanIfPublicReadRxPduNotifyStatusApi = 0
      CanIfPublicReadTxPduNotifyStatusApi = 0
      CanIfPublicSetDynamicTxIdApi = 0
      CanIfPublicTxBuffering = 0
      CanIfPublicTxConfirmPollingSupport = 0
      CanIfPublicVersionInfoApi = 0
      CanIfPublicWakeupCheckValidSupport = 0
      ArcCanIfPublicTxBufferSize = 0
      ArcCanIfPublicMaxNumberOfTxBuffers = 0
  module config Com: implementation-config-variant=VARIANT-POST-BUILD, module-description=Com
    ComConfig: ComConfigurationId=(unset)
      ComTimeBase: ComRxTimeBase=0.005, ComTxTimeBase=0.005
      acknowledgementSCUComIPdu (ComIPdu):
        ComIPduDirection = SEND
        ComIPduSignalProcessing = IMMEDIATE
        ComIPduTriggerTransmitCallout = NULL
        ComIPduType = 
        ComPduIdRef = acknowledegmentSCUPdu
        ComIPduGroupRef = TxComIPduGroup
        ComIPduSignalRef = acknowledgementSCUsignal
        ComTxIPdu: ComTxIPduUnusedAreasDefault=0
          ComTxModeTrue
            ComTxMode: ComTxModeMode=DIRECT
      RxComIPduGroup (ComIPduGroup): ComIPduGroupHandleId=(unset)
      6 x ComSignal, all with ComBitPosition=0, ComHandleId=(unset), ComSignalEndianness=opaque, ComSignalType=UINT8_N:
        pluginCommunicationSCUtoVCUsignal: ComTransferProperty=TRIGGERED, ComSignalInitValue=0x00, ComSignalLength=8, ComSystemTemplateSystemSignalRef=pluginCommunicationSCUtoVCUsignalargInt32Mapping
        pluginCommunicationTCUtoSCUsignal: ComTransferProperty=PENDING, ComSignalInitValue=0x00, ComSignalLength=8, ComSystemTemplateSystemSignalRef=pluginCommunicationTCUtoSCUsignalargInt32Mapping
        pluginCommunicationVCUtoSCUsignal: ComTransferProperty=PENDING, ComSignalInitValue=0x00, ComSignalLength=8, ComSystemTemplateSystemSignalRef=pluginCommunicationVCUtoSCUsignalargInt32Mapping
        acknowledgementSCUsignal: ComTransferProperty=TRIGGERED, ComSignalInitValue=0, ComSignalLength=1, ComSystemTemplateSystemSignalRef=acknowledgementSCUsignalacknowledgementVCUMapping
        pluginInstallationSCUsignal: ComTransferProperty=PENDING, ComSignalInitValue=0x00, ComSignalLength=8, ComUpdateBitPosition=0, ComSystemTemplateSystemSignalRef=pluginInstallationSCUsignalargInt32Mapping
        pluginCommunicationSCUtoTCUsignal: ComTransferProperty=TRIGGERED, ComSignalInitValue=0, ComSignalLength=8, ComSystemTemplateSystemSignalRef=pluginCommunicationSCUtoTCUsignalargInt32Mapping
      TxComIPduGroup (ComIPduGroup): ComIPduGroupHandleId=(unset)
      5 x ComIPdu, all with ComIPduSignalProcessing=IMMEDIATE, ComIPduTriggerTransmitCallout=NULL, ComIPduType=:
        pluginCommunicationSCUtoTCUComIPdu: ComIPduDirection=SEND, ComPduIdRef=pluginCommunicationSCUtoTCUPdu, ComIPduSignalRef=pluginCommunicationSCUtoTCUsignal, ComIPduGroupRef=TxComIPduGroup
          ComTxIPdu: ComTxIPduUnusedAreasDefault=0
            ComTxModeTrue
              ComTxMode: ComTxModeMode=DIRECT
        pluginCommunicationSCUtoVCUComIPdu: ComIPduDirection=SEND, ComPduIdRef=pluginCommunicationSCUtoVCUPdu, ComIPduGroupRef=TxComIPduGroup, ComIPduSignalRef=pluginCommunicationSCUtoVCUsignal
          ComTxIPdu: ComTxIPduUnusedAreasDefault=0
            ComTxModeTrue
              ComTxMode: ComTxModeMode=DIRECT
        pluginCommunicationTCUtoSCUComIPdu: ComIPduDirection=RECEIVE, ComPduIdRef=pluginCommunicationTCUtoSCUPdu, ComIPduGroupRef=RxComIPduGroup, ComIPduSignalRef=pluginCommunicationTCUtoSCUsignal
        pluginCommunicationVCUtoSCUComIPdu: ComIPduDirection=RECEIVE, ComPduIdRef=pluginCommunicationVCUtoSCUPdu, ComIPduGroupRef=RxComIPduGroup, ComIPduSignalRef=pluginCommunicationVCUtoSCUsignal
        pluginInstallationSCUComIPdu: ComIPduDirection=RECEIVE, ComPduIdRef=pluginInstallationSCUPdu, ComIPduGroupRef=RxComIPduGroup, ComIPduSignalRef=pluginInstallationSCUsignal
    ComGeneral:
      ComSupportedIPduGroups = 4
      ComVersionInfoApi = 0
      ComSupportedIPdus = 20
      ComSupportedSignals = 40
      ComSupportedGroupSignals = 40
      ComRamBufferSize = 150
      ComConfigurationUseDet = 1
  module config PduR: implementation-config-variant=VARIANT-POST-BUILD, module-description=PduR
    PduRGeneral: PduRDevErrorDetect=0, PduRVersionInfoApi=0, PduRZeroCostOperation=1
    PduRRoutingTables: PduRConfigurationId=0, ArcPduRMaxRouteCount=30
      PduRRoutingTable: PduRIsMinimumRouting=0
        6 x PduRRoutingPath:
          acknowledgementSCUtx
            PduRDestPdu: ArcOverridenDestModule=CanIf, PduRDestPduRef=acknowledegmentSCUPdu
            PduRSrcPdu: PduRSourcePduHandleId=(unset), ArcOverridenSrcModule=Com, PduRSrcPduRef=acknowledegmentSCUPdu
          pluginCommunicationSCUtoTCUtx
            PduRDestPdu: ArcOverridenDestModule=CanIf, PduRDestPduRef=pluginCommunicationSCUtoTCUPdu
            PduRSrcPdu: PduRSourcePduHandleId=(unset), ArcOverridenSrcModule=Com, PduRSrcPduRef=pluginCommunicationSCUtoTCUPdu
          pluginCommunicationSCUtoVCUtx
            PduRDestPdu: ArcOverridenDestModule=CanIf, PduRDestPduRef=pluginCommunicationSCUtoVCUPdu
            PduRSrcPdu: PduRSourcePduHandleId=(unset), ArcOverridenSrcModule=Com, PduRSrcPduRef=pluginCommunicationSCUtoVCUPdu
          pluginCommunicationTCUtoSCUrx
            PduRDestPdu: ArcOverridenDestModule=Com, PduRDestPduRef=pluginCommunicationTCUtoSCUPdu
            PduRSrcPdu: PduRSourcePduHandleId=(unset), ArcOverridenSrcModule=CanIf, PduRSrcPduRef=pluginCommunicationTCUtoSCUPdu
          pluginCommunicationVCUtoSCUrx
            PduRDestPdu: ArcOverridenDestModule=Com, PduRDestPduRef=pluginCommunicationVCUtoSCUPdu
            PduRSrcPdu: PduRSourcePduHandleId=(unset), ArcOverridenSrcModule=CanIf, PduRSrcPduRef=pluginCommunicationVCUtoSCUPdu
          pluginInstallationSCUrx
            PduRDestPdu: ArcOverridenDestModule=Com, PduRDestPduRef=pluginInstallationSCUPdu
            PduRSrcPdu: PduRSourcePduHandleId=(unset), ArcOverridenSrcModule=CanIf, PduRSrcPduRef=pluginInstallationSCUPdu
    CanIf (PduRBswModules):
      PduRCancelReceive = 0
      PduRCancelTransmit = (unset)
      PduRChangeParameterRequestApi = (unset)
      PduRCommunicationInterface = (unset)
      PduRLowerModule = 1
      PduRRetransmission = (unset)
      PduRTransportProtocol = (unset)
      PduRTriggertransmit = (unset)
      PduRTxConfirmation = (unset)
      PduRUpperModule = 0
      PduRUseTag = (unset)
      PduRBswModuleRef = (unset)
    Com (PduRBswModules):
      PduRCancelReceive = 0
      PduRCancelTransmit = (unset)
      PduRChangeParameterRequestApi = (unset)
      PduRCommunicationInterface = (unset)
      PduRLowerModule = 0
      PduRRetransmission = (unset)
      PduRTransportProtocol = (unset)
      PduRTriggertransmit = (unset)
      PduRTxConfirmation = (unset)
      PduRUpperModule = 1
      PduRUseTag = (unset)
      PduRBswModuleRef = (unset)
  module config Can: implementation-config-variant=VARIANT-PRE-COMPILE, module-description=Can
    CanConfigSet
      CanController:
        CanBusoffProcessing = POLLING
        CanControllerActivation = 1
        CanControllerBaseAddress = (unset)
        CanControllerId = 0
        CanRxProcessing = POLLING
        CanTxProcessing = POLLING
        CanWakeupProcessing = POLLING
        CanWakeupSupport = 0
        ArcCanControllerLoopback = 0
        CanControllerDefaultBaudrate = CanControllerBaudrateConfig
        CanCpuClockRef = (unset)
        CanControllerBaudrateConfig: CanControllerBaudRate=500, CanControllerPropSeg=6, CanControllerSeg1=6, CanControllerSeg2=3, CanControllerSyncJumpWidth=2
        CanFilterMask: CanFilterMaskValue=0
      CAN_RX (CanHardwareObject):
        CanHandleType = BASIC
        CanIdType = STANDARD
        CanIdValue = 2
        CanObjectId = (unset)
        CanObjectType = RECEIVE
        CanControllerRef = CanController
        CanFilterMaskRef = CanFilterMask
      CAN_TX (CanHardwareObject):
        CanHandleType = BASIC
        CanIdType = STANDARD
        CanIdValue = 1
        CanObjectId = (unset)
        CanObjectType = TRANSMIT
        CanControllerRef = CanController
        CanFilterMaskRef = CanFilterMask
    CanGeneral:
      CanChangeBaudrateApi = 0
      CanDevErrorDetection = 1
      CanHardwareCancellation = 0
      CanIdenticalIdCancellation = 0
      CanIndex = (unset)
      CanMainFunctionModePeriod = (unset)
      CanMultiplexedTransmission = 0
      CanTimeoutDuration = (unset)
      CanVersionInfoApi = 0
      CanCounterRef = (unset)
      CanSupportTTCANRef = (unset)
      CanMainFunctionRWPeriods
